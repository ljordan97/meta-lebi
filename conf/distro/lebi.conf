## conf/distro/lebi.conf
```bitbake
require conf/distro/poky.conf

DISTRO = "lebi"
DISTRO_NAME = "Lebi"
DISTRO_VERSION = "1.0"
```

## conf/layer.conf
```bitbake
# We have a conf and classes directory, add to BBPATH
BBPATH .= ":${LAYERDIR}"

# We have recipes-* directories, add to BBFILES
BBFILES += "${LAYERDIR}/recipes-*/*/*.bb \
            ${LAYERDIR}/recipes-*/*/*.bbappend"

BBFILE_COLLECTIONS += "meta-lebi"
BBFILE_PATTERN_meta-lebi = "^${LAYERDIR}/"
BBFILE_PRIORITY_meta-lebi = "6"

LAYERDEPENDS_meta-lebi = "core"
LAYER_PRIORITY_mycustomdistro = "99"
LAYERSERIES_COMPAT_meta-lebi = "scarthgap styhead"

# Set custom distribution
DISTRO ?= "lebi"

# Number of threads BitBake should use
BB_NUMBER_THREADS ?= "4"

# Number of parallel make threads
PARALLEL_MAKE ?= "-j 4"

# allow pi base to build
LICENSE_FLAGS_ACCEPTED = "synaptics-killswitch"

# enable raspberry pi UART
ENABLE_UART ?= "1"

# enable i2c for camera (and possibly display)
ENABLE_I2C = "1"

# enable camera
RASPBERRYPI_CAMERA_V3 ?= "1"

# enable video camera
VIDEO_CAMERA ?= "1"

RPI_EXTRA_CONFIG = ' \n \
    # Raspberry Pi 7\" display/touch screen \n \
    lcd_rotate=2 \n \
    dtoverlay=vc4-kms-dsi-7inch \n \
    '
```
